## manifest-repo/west.yml
```yaml
manifest:
  remotes:
    - name: zephyrproject-rtos
      url-base: https://github.com/zephyrproject-rtos
    - name: zellaco
      url-base: https://github.com/Zellaco
  projects:
    - name: zephyr
      remote: zephyrproject-rtos
      revision: v3.1.0
      import: false # Set to true if all submodules should be imported
      west-commands: scripts/west-commands.yml
    - name: zephyrblog_example1
      remote: zellaco
      revision: main
  self:
    path: manifest-repo
```
